## meta-securebox/conf/machine/securebox.conf
```bitbake
#@TYPE: Machine
#@NAME: securebox

#@DESCRIPTION: Machine configuration for securebox systems


PREFERRED_PROVIDER_virtual/kernel ?= "linux-yocto"
PREFERRED_VERSION_linux-yocto ?= "3.10%"

require conf/machine/include/tune-x86_64.inc
require conf/machine/include/ia32-base.inc

MACHINE_FEATURES += "wifi efi pcbios"



MACHINE_EXTRA_RRECOMMENDS += "linux-firmware v86d"

GLIBC_ADDONS = "nptl"

EXTRA_OECONF_append_pn-matchbox-panel-2 = " --with-battery=acpi"
```
